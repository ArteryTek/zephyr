## dts/bindings/gpio/at,at32-iomux.yaml
```yaml
# Copyright (c) 2021 Teslabs Engineering S.L.
# SPDX-License-Identifier: Apache-2.0

description: AT32 iomux Registers

compatible: "at,at32-iomux"

include: base.yaml

properties:
  reg:
    required: true

  clocks:
    required: true
```

## dts/bindings/mtd/at,at32-nv-flash-v1.yaml
```yaml
description: |
  AT32 V1 flash memory.

include: at,at32-nv-flash.yaml

compatible: at,at32-nv-flash-v1
```

## dts/bindings/mtd/at,at32-nv-flash.yaml
```yaml
description: |
  AT32 flash memory.

  This binding is for the flash memory itself, not the flash controller peripheral.
  For that, see the "at,at32-flash-controller" binding.

include: soc-nv-flash.yaml

compatible: at,at32-nv-flash

properties:
  max-erase-time:
    type: int
    description: max erase time(millisecond) of a flash sector or page or half-page
    required: true
  bank2-flash-size:
    type: int
    description: |
      Embedded flash memory bank 2 size in KBytes.
      Used by CM4 CPU because it cannot access flash controller register to read size.
      Provides a way to configure this size when the flash controller driver runs on CM4 CPU.
  page-size:
    type: int
    description: the flash page size
    required: true
  write-block-size:
    required: true
    type: int
    enum:
      - 1
      - 2
      - 4
      - 8
    default: 1
    description: |
      Number of bytes used in write operations. Default value is based on the
      reset value of Flash Control Register (FLASH_CTRL).
```

## dts/bindings/pwm/at,at32-pwm.yaml
```yaml
description: AT32 PWM

compatible: "at,at32-pwm"

include: [pwm-controller.yaml, base.yaml, pinctrl-device.yaml]

properties:
  pinctrl-0:
    required: true

  pinctrl-names:
    required: true

  four-channel-capture-support:
    type: boolean
    description: |
      Add support to capture on four channels. This is less accurate than
      the default 2 channel support because the counter is reset by
      interrupt instead of slave-mode controller. This option can also
      be used as alternative for timers that does not support slave mode.

  "#pwm-cells":
    const: 3
    description: |
      Number of items to expect in a PWM
      - channel of the timer used for PWM
      - period to set in ns
      - flags

pwm-cells:
  - channel
  - period
  - flags
```

## dts/bindings/usb/at,at32-otg-dwc2.yaml
```yaml
# Copyright (c) 2023 Nordic Semiconductor ASA
# SPDX-License-Identifier: Apache-2.0
#
description: AT32 OTG_FS/HS DWC2 compatible controller.

compatible: "at,at32-otg-dwc2"

include: ["snps,dwc2.yaml", pinctrl-device.yaml]

properties:
  clocks:
    required: true

  pinctrl-0:
    required: true

  pinctrl-names:
    required: true
```

## dts/bindings/usb/at,at32-usb.yaml
```yaml
# Copyright (c) 2017, I-SENSE group of ICCS
# SPDX-License-Identifier: Apache-2.0

description: AT32 USB controller

compatible: "at,at32-usb"

include: [usb-ep.yaml, pinctrl-device.yaml]

properties:
  reg:
    required: true

  interrupts:
    required: true

  ram-size:
    type: int
    required: true
    description: |
      Size of USB dedicated RAM. AT32 SOC's reference
      manual defines USB packet SRAM size.

  disconnect-gpios:
    type: phandle-array
    description: |
      Some boards use a USB DISCONNECT pin to enable
      the pull-up resistor on USB Data Positive signal.

  phys:
    type: phandle
    description: PHY provider specifier

  clocks:
    required: true
```

## dts/bindings/watchdog/at,at32-watchdog.yaml
```yaml
# Copyright (c) 2019, Linaro Limited
# SPDX-License-Identifier: Apache-2.0

description: AT32 watchdog

compatible: "at,at32-watchdog"

include: base.yaml

properties:
  reg:
    required: true
```

## dts/bindings/watchdog/at,at32-window-watchdog.yaml
```yaml
# Copyright (c) 2019 Centaur Analytics, Inc
# SPDX-License-Identifier: Apache-2.0

description: AT32 system window watchdog

compatible: "at,at32-window-watchdog"

include: base.yaml

properties:
  reg:
    required: true

  clocks:
    required: true
```

## soc/at/at32/at32f403A_407/Kconfig.soc
```kconfig
# Copyright (c) 2024, Maxjta
# SPDX-License-Identifier: Apache-2.0

config SOC_SERIES_AT32F403A_407
	bool
	select SOC_FAMILY_AT32
	help
	  Enable support for Artery AT32F403A_407 MCU series

config SOC_SERIES
	default "at32f403a_407" if SOC_SERIES_AT32F403A_407

config SOC_AT32F403A
	bool
	select SOC_SERIES_AT32F403A_407

config SOC_AT32F407
	bool
	select SOC_SERIES_AT32F403A_407

config SOC
	default "at32f403a" if SOC_AT32F403A
	default "at32f407" if SOC_AT32F407
```

## soc/at/at32/at32f423/Kconfig.defconfig
```kconfig
# Copyright (c) 2025 Maxjta
# SPDX-License-Identifier: Apache-2.0

if SOC_SERIES_AT32F423

rsource "Kconfig.defconfig.at32*"

endif # SOC_SERIES_AT32F423
```

## soc/at/at32/at32f423/Kconfig.defconfig.at32f423
```kconfig
# Copyright (c) 2021, ATL Electronics
# SPDX-License-Identifier: Apache-2.0

if SOC_AT32F423

config NUM_IRQS
	default 104

endif # SOC_AT32F423
```

## soc/at/at32/at32f423/Kconfig.soc
```kconfig
# Copyright (c) 2024, Maxjta
# SPDX-License-Identifier: Apache-2.0

config SOC_SERIES_AT32F423
	bool
	select SOC_FAMILY_AT32
	help
	  Enable support for Artery AT32F423 MCU series

config SOC_SERIES
	default "at32f423" if SOC_SERIES_AT32F423

config SOC_AT32F423
	bool
	select SOC_SERIES_AT32F423

config SOC
	default "at32f423" if SOC_AT32F423
```

## soc/at/at32/at32f435_437/Kconfig.defconfig
```kconfig
# Copyright (c) 2025 Maxjta
# SPDX-License-Identifier: Apache-2.0

if SOC_SERIES_AT32F435_437

rsource "Kconfig.defconfig.at32*"

endif # SOC_SERIES_AT32F435_437
```

## soc/at/at32/at32f435_437/Kconfig.soc
```kconfig
# Copyright (c) 2024, Maxjta
# SPDX-License-Identifier: Apache-2.0

config SOC_SERIES_AT32F435_437
	bool
	select SOC_FAMILY_AT32
	help
	  Enable support for Artery AT32F435_437 MCU series

config SOC_SERIES
	default "at32f435_437" if SOC_SERIES_AT32F435_437

config SOC_AT32F435
	bool
	select SOC_SERIES_AT32F435_437

config SOC_AT32F437
	bool
	select SOC_SERIES_AT32F435_437

config SOC
	default "at32f435" if SOC_AT32F435
	default "at32f437" if SOC_AT32F437
```
