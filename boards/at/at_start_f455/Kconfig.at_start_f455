## boards/at/at_start_f455/Kconfig.at_start_f455
```kconfig
# Copyright (c) 2018 Philémon Jaermann
# SPDX-License-Identifier: Apache-2.0

config BOARD_AT_START_F455
	select SOC_AT32F455
```

## boards/at/at_start_f456/Kconfig.at_start_f456
```kconfig
# Copyright (c) 2018 Philémon Jaermann
# SPDX-License-Identifier: Apache-2.0

config BOARD_AT_START_F456
	select SOC_AT32F456
```

## boards/at/at_start_f457/Kconfig.at_start_f457
```kconfig
# Copyright (c) 2018 Philémon Jaermann
# SPDX-License-Identifier: Apache-2.0

config BOARD_AT_START_F457
	select SOC_AT32F457
```

## soc/at/at32/at32f45x/Kconfig.soc
```kconfig
# Copyright (c) 2024, Maxjta
# SPDX-License-Identifier: Apache-2.0

config SOC_SERIES_AT32F45X
	bool
	select SOC_FAMILY_AT32
	help
	  Enable support for Artery AT32F45X MCU series

config SOC_SERIES
	default "at32f45x" if SOC_SERIES_AT32F45X

config SOC_AT32F455
	bool
	select SOC_SERIES_AT32F45X

config SOC_AT32F456
	bool
	select SOC_SERIES_AT32F45X

config SOC_AT32F457
	bool
	select SOC_SERIES_AT32F45X

config SOC
	default "at32f455" if SOC_AT32F455
	default "at32f456" if SOC_AT32F456
	default "at32f456" if SOC_AT32F457
```
