## boards/at/at_start_f403a/Kconfig.at_start_f403a
```kconfig
# Copyright (c) 2018 Philémon Jaermann
# SPDX-License-Identifier: Apache-2.0

config BOARD_AT_START_F403A
	select SOC_AT32F403A
```

## boards/at/at_start_f405/at_start_f405_defconfig
```kconfig
# SPDX-License-Identifier: Apache-2.0

#Config Default System clock
CONFIG_SYS_CLOCK_HW_CYCLES_PER_SEC=216000000
 
# Enable MPU
CONFIG_ARM_MPU=n

# Enable HW stack protection
CONFIG_HW_STACK_PROTECTION=n

# Enable Reset
CONFIG_RESET=y

# Enable GPIO
CONFIG_GPIO=y
CONFIG_PINCTRL=y

# console
CONFIG_SERIAL=y
CONFIG_CONSOLE=y
CONFIG_UART_CONSOLE=y

#enable SPI
#CONFIG_SPI=y
#CONFIG_SPI_AT32_DMA=y

#enable usb
CONFIG_USB_DEVICE_VID=0x2E3C
CONFIG_UART_CONSOLE=y

CONFIG_DMA=y
CONFIG_ADC_AT32_DMA=y
```

## boards/at/at_start_f407/at_start_f407_defconfig
```kconfig
# SPDX-License-Identifier: Apache-2.0

# Enable Reset
CONFIG_RESET=y

# Enable GPIO
CONFIG_GPIO=y
#CONFIG_PINCTRL=y

# console
CONFIG_SERIAL=y
CONFIG_CONSOLE=y
CONFIG_UART_CONSOLE=y

#enable SPI
#CONFIG_SPI=y
#CONFIG_SPI_AT32_DMA=y

#enable usb
CONFIG_USB_DEVICE_VID=0x2E3C
CONFIG_UART_CONSOLE=y

#CONFIG_DMA=y
#CONFIG_ADC_AT32_DMA=y
```

## boards/at/at_start_f423/Kconfig.at_start_f423
```kconfig
# Copyright (c) 2018 Philémon Jaermann
# SPDX-License-Identifier: Apache-2.0

config BOARD_AT_START_F423
	select SOC_AT32F423
```

## boards/at/at_start_f435/Kconfig.at_start_f435
```kconfig
# Copyright (c) 2018 Philémon Jaermann
# SPDX-License-Identifier: Apache-2.0

config BOARD_AT_START_F435
	select SOC_AT32F435
```

## boards/at/at_start_f437/Kconfig.at_start_f437
```kconfig
# Copyright (c) 2018 Philémon Jaermann
# SPDX-License-Identifier: Apache-2.0

config BOARD_AT_START_F437
	select SOC_AT32F437
```

## drivers/adc/Kconfig.at32
```kconfig
# ADC configuration options

# Copyright (c) 2019 Intel Corporation
# Copyright (c) 2019 Endre Karlson
# Copyright (c) 2019 Song Qiang <songqiang1304521@gmail.com>
# Copyright (c) 2021 Marius Scholtz, RIC Electronics
# Copyright (c) 2022 Hein Wessels, Nobleo Technology
# Copyright (c) 2025 Maxjta
# SPDX-License-Identifier: Apache-2.0

config ADC_AT32
	bool "AT32 ADC driver"
	default y
	depends on DT_HAS_AT_AT32_ADC_ENABLED
	select PINCTRL
	select USE_AT32_ADC
	help
	  Enable the driver implementation for the at32xx ADC

if ADC_AT32

config ADC_AT32_DMA
	bool "AT32 MCU ADC DMA Support"
	select DMA
	help
	  Enable the ADC DMA mode for ADC instances
	  that enable dma channels in their device tree node.

endif
```

## drivers/can/Kconfig.at32
```kconfig
# AT32 CAN configuration options

# Copyright (c) 2022 Blue Clover
# Copyright (c) 2018-2020 Alexander Wachter
# SPDX-License-Identifier: Apache-2.0

config CAN_AT32_BXCAN
	bool "AT32 bxCAN driver"
	default y
	depends on DT_HAS_AT_AT32_BXCAN_ENABLED
	select PINCTRL
	select USE_AT32_CAN
	help
	  Enable AT32 bxCAN Driver.

if CAN_AT32_BXCAN

config CAN_MAX_STD_ID_FILTER
	int "Maximum number of standard (11-bit) ID filters"
	default 14
	range 0 14
	help
	  Defines the maximum number of filters with standard ID (11-bit)
	  that can be added by the application.

	  One standard ID filter with mask occupies 1/2 of the 14 available
	  filter banks.

	  The following equation determines the maximum total number of
	  filters:

	    CAN_MAX_STD_ID_FILTER + CAN_MAX_EXT_ID_FILTER * 2 <= 28

config CAN_MAX_EXT_ID_FILTER
	int "Maximum number of extended (29-bit) ID filters"
	default 14
	range 0 14
	help
	  Defines the maximum number of filters with extended ID (29-bit)
	  that can be added by the application.

	  One extended ID filter with mask occupies 1 of the 14 available
	  filter banks.

	  The following equation determines the maximum total number of
	  filters:

	    CAN_MAX_STD_ID_FILTER + CAN_MAX_EXT_ID_FILTER * 2 <= 28

endif # CAN_AT32_BXCAN
```

## drivers/counter/Kconfig.at32
```kconfig
# GD32 counter timer configuration options

# Copyright (c) 2022 TOKITA Hiroshi <tokita.hiroshi@gmail.com>
# SPDX-License-Identifier: Apache-2.0

config COUNTER_TIMER_AT32
	bool "AT32 timer counter driver"
	default y
	depends on DT_HAS_AT_AT32_TIMER_ENABLED
	select USE_AT32_TIMER
	help
	  Enable counter timer driver for AT32 series devices.
```

## drivers/dma/Kconfig.at32
```kconfig
# Copyright (c) 2022 Tokita, Hiroshi <tokita.hiroshi@gmail.com>
# SPDX-License-Identifier: Apache-2.0

config DMA_AT32
	bool "AT32 DMA driver"
	default y
	depends on DT_HAS_AT_AT32_DMA_ENABLED || DT_HAS_AT_AT32_DMA_V1_ENABLED
	select USE_AT32_DMA
	help
	  DMA driver for AT32 series MCUs.
```

## drivers/flash/Kconfig.at32
```kconfig
# ST Microelectronics AT32 MCUs Flash driver config

# Copyright (c) 2016 RnDity Sp. z o.o.
# Copyright (c) 2017 BayLibre, SAS
# Copyright (c) 2022 Linaro Limited
# Copyright (c) 2023 Google Inc
# Copyright (c) 2025 Maxjta
# SPDX-License-Identifier: Apache-2.0

config SOC_FLASH_AT32
	bool "AT32 flash driver"
	depends on DT_HAS_AT_AT32_FLASH_CONTROLLER_ENABLED
	select FLASH_HAS_DRIVER_ENABLED
	default y
	select USE_AT32_FLASH
	select FLASH_HAS_PAGE_LAYOUT
	select FLASH_HAS_EXPLICIT_ERASE
	help
	  Enable flash driver for AT32 series
```

## drivers/i2c/Kconfig.at32
```kconfig
# Copyright (c) 2021 BrainCo Inc.
# SPDX-License-Identifier: Apache-2.0

config I2C_AT32
	bool "AT32 I2C driver"
	default y
	depends on DT_HAS_AT_AT32_I2C_V1_ENABLED || DT_HAS_AT_AT32_I2C_V2_ENABLED || DT_HAS_AT_AT32_I2C_ENABLED
	select PINCTRL
	select USE_AT32_I2C
	help
	  Enable I2C support on the AT32 SoCs

config I2C_AT32_INTERRUPT
	bool "AT32 MCU I2C Interrupt Support"
	depends on I2C_AT32
	default y
	help
	  Enable Interrupt support for the I2C Driver

config I2C_AT32_V2_TIMING
	bool "compute the I2C V2 bus timing"
	depends on I2C_AT32
	help
	  Enable AT32 driver bus to calculate the Timing.
```

## drivers/i2s/Kconfig.at32
```kconfig
# AT32 I2S driver configuration options

# Copyright (c) 2025 Maxjta 
# SPDX-License-Identifier: Apache-2.0

menuconfig I2S_AT32
	bool "AT32 MCU I2S controller driver"
	default y
	depends on DT_HAS_AT_AT32_I2S_ENABLED
	select CACHE_MANAGEMENT if CPU_HAS_DCACHE
	select USE_AT32_SPI
	select DMA
	select PINCTRL
	help
	  Enable I2S support on the AT32 family of processors.

if I2S_AT32

config I2S_AT32_RX_BLOCK_COUNT
	int "RX queue length"
	default 4

config I2S_AT32_TX_BLOCK_COUNT
	int "TX queue length"
	default 4

endif # I2S_AT32
```

## drivers/pwm/Kconfig.at32
```kconfig
# STM32 PWM configuration options

# Copyright (c) 2016 Linaro Limited.
# SPDX-License-Identifier: Apache-2.0

config PWM_AT32
	bool "AT32 MCU PWM driver"
	default y
	depends on DT_HAS_AT_AT32_PWM_ENABLED
	select USE_AT32_TIMER
	select RESET
	select PINCTRL
	help
	  This option enables the PWM driver for AT32 family of
	  processors. Say y if you wish to use PWM port on AT32
	  MCU.
```

## drivers/spi/Kconfig.at32
```kconfig
# Copyright (c) 2021 BrainCo Inc.
# SPDX-License-Identifier: Apache-2.0

config SPI_AT32
	bool "AT32 SPI driver"
	default y
	depends on DT_HAS_AT_AT32_SPI_ENABLED
	select USE_AT32_SPI
	help
	  Enables AT32 SPI driver.

if SPI_AT32

config SPI_AT32_INTERRUPT
	bool "AT32 MCU SPI Interrupt Support"
	default y if SPI_ASYNC
	default y if SPI_AT32_DMA
	help
	  Enable the interrupt driven mode for SPI instances

config SPI_AT32_DMA
	bool "AT32 MCU SPI DMA Support"
	select DMA
	select SPI_AT32_INTERRUPT
	help
	  Use the DMA for SPI transfer
	  that enable dma channels in their device tree node.

endif # SPI_AT32
```

## drivers/usb/udc/Kconfig.at32
```kconfig
# Copyright (c) 2023 Linaro Limited
# SPDX-License-Identifier: Apache-2.0

config UDC_AT32
	bool "AT32 USB device controller driver"
	default y
	depends on DT_HAS_AT_AT32_USB_ENABLED
	select USE_AT32_USB
	help
	  AT32 USB device controller driver.

if UDC_AT32

config UDC_AT32_STACK_SIZE
	int "UDC controller driver internal thread stack size"
	default 512
	help
	  AT32 USB device controller driver internal thread stack size.

config UDC_AT32_THREAD_PRIORITY
	int "AT32 USB controller driver thread priority"
	default 8
	help
	  AT32 USB device controller driver thread priority.

config UDC_AT32_MAX_QMESSAGES
	int "AT32 UDC driver maximum number of ISR event messages"
	range 4 64
	default 8
	help
	  Maximum number of messages for handling of STM32 USBD ISR events.

config UDC_AT32_CLOCK_CHECK
	bool "Runtime USB 48MHz clock check"
	default y
	help
	  Enable USB clock 48MHz configuration runtime check.
	  In specific cases, this check might provide wrong verdict and should
	  be disabled.

endif
```

## drivers/watchdog/Kconfig.at32
```kconfig
# AT32 IWDG configuration

# Copyright (c) 2016 Open-RnD Sp. z o.o.
# Copyright (c) 2017 RnDity Sp. z o.o.
# Copyright (c) 2019 Centaur Analytics, Inc
# SPDX-License-Identifier: Apache-2.0

menuconfig WDT_AT32
	bool "Watchdog Timer(WDT) Driver for AT32 family of MCUs"
	default y
	depends on DT_HAS_AT_AT32_WATCHDOG_ENABLED
	select HAS_WDT_DISABLE_AT_BOOT
	select HAS_WDT_NO_CALLBACKS
	select USE_AT32_WDT
	help
	  Enable WDT driver for AT32 line of MCUs

config WDT_AT32_INITIAL_TIMEOUT
	int "Value for WDT timeout in ms"
	depends on WDT_AT32
	default 100
	range 1 26214
	help
	  Set initial timeout value for WDT in ms if enabled at boot.

	  The min timeout supported is 1 ms. The max timeout depends on the
	  MCU's LSI clock frequency and can be calculated with:

	    max. prescaler value (256) * max. reload ticks (4096) / LICK freq.

	  Limiting maximum timeout to a safe value of 26214 ms here, which was
	  calculated for highest LICK frequency among AT32 MCUs of 40 kHz.

config WWDT_AT32
	bool "System Window Watchdog (WWDG) Driver for AT32 family of MCUs"
	default y
	depends on DT_HAS_AT_AT32_WINDOW_WATCHDOG_ENABLED
	select USE_AT32_WWDT
	help
	  Enable WWDT driver for AT32 line of MCUs
```

## dts/bindings/adc/at,at32-adc.yaml
```yaml
# Copyright (c) 2018, Endre Karlson
# Copyright (c) 2018, Song Qiang <songqiang1304521@gmail.com>
# SPDX-License-Identifier: Apache-2.0

description: AT32 ADC

compatible: "at,at32-adc"

include: [adc-controller.yaml, pinctrl-device.yaml]

properties:
  reg:
    required: true

  clocks:
    required: true

  interrupts:
    required: true

  "#io-channel-cells":
    const: 1

  at,adc-clock-source:
    type: string
    required: true
    enum:
      - "SYNC"
      - "ASYNC"
    description: |
      Type of ADC clock source :
      - "SYNC": derived from the bus clock.
      - "ASYNC" : independent and asynchronous with the bus clock
      One of the two values may not apply to some series. Refer to the RefMan.
      If an asynchronous clock is selected, a domain clock in the clock property
      has to be defined explicitly.

  at,adc-prescaler:
    type: int
    required: true
    enum:
      - 0 # 2 divided
      - 1
      - 2
      - 3
      - 4
      - 5
      - 6
      - 7
      - 8
      - 9
      - 10
      - 11
      - 12
      - 13
      - 14
      - 15
    description: |
      Clock prescaler at the input of the ADC:
      Apply to synchronous or asynchronous clock depending on the AT32
      at,adc-clock-source.

  vref-mv:
    type: int
    default: 3300
    description: Indicates the reference voltage of the ADC in mV (on the target board).

  resolutions:
    type: array
    required: true
    description: |
      List of the resolutions supported by the ADC instance. They should be
      values created with AT32 macro or similar. Their order is not
      important. For example for AT32F45X:
      <12> <10> <8> <6>)
      The two parameters are the resolution (for example 10 bits) and the
      corresponding register value (0x01 for a 10-bit resolution).
      By design, these macros also contains all register information (address,
      field offset and field mask) necessary to properly set the resolution.

  sampling-times:
    type: array
    required: true
    description: |
      List all the sampling times supported by the ADC instance.
      Rounded up if needed. Order is important: their index matches their binary
      value in the register.

  num-sampling-time-common-channels:
    type: int
    description: |
      Number of sampling time common channels for this ADC instance, if any.

  at,adc-sequencer:
    type: string
    required: true
    enum:
      - "NOT_FULLY_CONFIGURABLE"
      - "FULLY_CONFIGURABLE"
    description: |
      Type of ADC sequencer:
      - "NOT_FULLY_CONFIGURABLE": Not fully configurable sequencer
      - "FULLY_CONFIGURABLE": Fully configurable sequencer

  at,adc-oversampler:
    type: string
    required: false
    enum:
      - "OVERSAMPLER_NONE"
      - "OVERSAMPLER_MINIMAL"
      - "OVERSAMPLER_EXTENDED"
    description: |
      Type of ADC oversampler:
      - "OVERSAMPLER_NONE": No oversampler
      - "OVERSAMPLER_MINIMAL": Oversampler with 8 possible oversampling values (2, 4, 8, ..., 256)
      - "OVERSAMPLER_EXTENDED": Oversampler with 1024 possible oversampling values (1..1024)

io-channel-cells:
  - input
```

## dts/bindings/clock/at,at32-pll-mul.yaml
```yaml
# Copyright (c) 2021, Linaro ltd
# SPDX-License-Identifier: Apache-2.0

description: |

  Takes one of 'clk_hext', 'clk_hext / 2' (when 'xtpre' is set) or 'clk_hsi / 2'
  as input clock.

  Output clock frequency can be computed with the following formula:

    f(PLLCLK) = f(input clk) x PLLMUL  --> SYSCLK (System Clock)

compatible: "at,at32-pll-mul"

include: [clock-controller.yaml, base.yaml]

properties:
  "#clock-cells":
    const: 0

  clocks:
    required: true

  mul:
    type: int
    required: true
    description: |
        Main PLL multiplication factor for VCO
        Valid range: 0 - 64

  xtpre:
    type: int
    description: |
        Optional HEXT divider for PLL entry

  div_fu:
    type: int
    description: |
        Optional PLL output divisor to generate a 48MHz USB clock.
        When set, PLL clock is not divided.
        Otherwise, PLL output clock is divided by 1.5.
```

## dts/bindings/flash_controller/at,at32-flash-controller.yaml
```yaml
description: AT32 flash controller

compatible: "at,at32-flash-controller"

include: flash-controller.yaml
```
